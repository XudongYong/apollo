VERSION "HNPBNNNYNNNNNNNNNNNNNNNNNNNNNNNNYNYYYYYYYY>4>%%%/4>'%**4YYY///"

NS_ :

BS_:

BU_: ACU VCU

BO_ 98 VC_Gas: 8 ACU
 SG_ VC_Gas : 7|16@0+ (0.1,0) [0|1] ""  VCU

BO_ 96 DM_Gas: 8 VCU
 SG_ DM_Gas : 7|16@0+ (0.1,0) [0|1] ""  ACU

BO_ 99 VC_Brake: 8 ACU
 SG_ VC_Brake : 7|16@0+ (0.1,0) [0|1] ""  VCU

BO_ 97 DM_Brake: 8 VCU
 SG_ DM_Brake : 7|16@0+ (0.1,0) [0|1] ""  ACU

BO_ 102 Cfg_Cruise_Speed: 8 VCU
 SG_ Cfg_Cruise_Speed : 7|16@0+ (0.1,0) [0|6553.5] ""  ACU

BO_ 101 Vhcl_POI_Ax_1: 8 VCU
 SG_ Vhcl_POI_Ax_1 : 7|16@0+ (0.1,0) [0|6553.5] ""  ACU

BO_ 100 Vhcl_Velocity: 8 VCU
 SG_ Vhcl_Velocity : 7|16@0+ (0.1,0) [0|6553.5] ""  ACU

CM_ SG_ 96 DM_Gas "Current output list type";
BA_DEF_  "BusType" STRING ;
BA_DEF_  "Version" HEX 0 255;
BA_DEF_  "NmMessageCount" INT 0 64;
BA_DEF_  "NWID" HEX 0 255;
BA_DEF_  "NBTMax" INT 0 255;
BA_DEF_  "NBTMin" INT 0 255;
BA_DEF_  "SamplePointMax" FLOAT 0 100;
BA_DEF_  "SamplePointMin" FLOAT 0 100;
BA_DEF_  "NWM-Basisadresse" HEX 0 536870911;
BA_DEF_  "NWM-Typ" ENUM  "zentral (MB-W210)","dezentral (MB-OSAN)","keines","VAG-OSEK","BMW-OSEK","PAG-OSEK","DBAG-OSEK";
BA_DEF_ BU_  "NWM-Knoten" ENUM  "nein","ja";
BA_DEF_  "Baudrate" INT 0 1000000;
BA_DEF_  "VersionWeek" INT 0 53;
BA_DEF_  "VersionYear" INT 0 99;
BA_DEF_  "Manufacturer" ENUM  "DBAG","VAG","BMWAG","PAG","GM","CONTI";
BA_DEF_DEF_  "BusType" "";
BA_DEF_DEF_  "Version" 176;
BA_DEF_DEF_  "NmMessageCount" 64;
BA_DEF_DEF_  "NWID" 11;
BA_DEF_DEF_  "NBTMax" 21;
BA_DEF_DEF_  "NBTMin" 9;
BA_DEF_DEF_  "SamplePointMax" 81.25;
BA_DEF_DEF_  "SamplePointMin" 75;
BA_DEF_DEF_  "NWM-Basisadresse" 1024;
BA_DEF_DEF_  "NWM-Typ" "keines";
BA_DEF_DEF_  "NWM-Knoten" "";
BA_DEF_DEF_  "Baudrate" 500000;
BA_DEF_DEF_  "VersionWeek" 44;
BA_DEF_DEF_  "VersionYear" 4;
BA_DEF_DEF_  "Manufacturer" "DBAG";
BA_ "VersionYear" 6;
BA_ "VersionWeek" 19;
BA_ "NWM-Basisadresse" 0;
BA_ "NWID" 0;
BA_ "NmMessageCount" 0;
BA_ "Version" 0;
BA_ "BusType" "CAN";
BA_ "NWM-Knoten" BU_ VCU 0;
